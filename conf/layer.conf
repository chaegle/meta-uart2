## conf/layer.conf
```bitbake
# We have a conf and classes directory, add to BBPATH
BBPATH .= ":${LAYERDIR}"

# We have recipes-* directories, add to BBFILES
BBFILES += "${LAYERDIR}/recipes-*/*/*.bb \
            ${LAYERDIR}/recipes-*/*/*.bbappend"

BBFILE_COLLECTIONS += "meta-uart2"
BBFILE_PATTERN_meta-uart2 = "^${LAYERDIR}/"
BBFILE_PRIORITY_meta-uart2 = "6"

LAYERDEPENDS_meta-uart2 = "core"
LAYERSERIES_COMPAT_meta-uart2 = "gatesgarth"
```
